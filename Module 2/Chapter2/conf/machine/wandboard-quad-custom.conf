## Module 2/Chapter2/conf/machine/wandboard-quad-custom.conf
```bitbake
#@TYPE: Machine
#@NAME: Wandboard i.MX6 Wandboard Quad Customized machine
#@SOC: i.MX6Q
#@DESCRIPTION: Custom Machine configuration for i.MX6 Wandboard Quad
#@MAINTAINER:

include conf/machine/include/wandboard.inc

SOC_FAMILY = "mx6:mx6q:wandboard"

UBOOT_MACHINE = "wandboard_quad_custom_config"

KERNEL_DEVICETREE = "imx6q-wandboard-custom.dtb"

MACHINE_FEATURES += "wifi"
```

## Module 2/Chapter5/conf/bblayers.conf
```bitbake
LCONF_VERSION = "6"

BBPATH = "${TOPDIR}"
BSPDIR := "${@os.path.abspath(os.path.dirname(d.getVar('FILE', True)) + '/../..')}"

BBFILES ?= ""
BBLAYERS = " \
  ${BSPDIR}/sources/poky/meta \
  ${BSPDIR}/sources/poky/meta-yocto \
  \
  ${BSPDIR}/sources/meta-openembedded/meta-oe \
  ${BSPDIR}/sources/meta-openembedded/meta-multimedia \
  \
  ${BSPDIR}/sources/meta-fsl-arm \
  ${BSPDIR}/sources/meta-fsl-arm-extra \
  ${BSPDIR}/sources/meta-fsl-demos \
  ${BSPDIR}/sources/meta-oracle-java \
  ${BSPDIR}/sources/meta-java \
  ${BSPDIR}/sources/meta-custom \
  ${BSPDIR}/sources/meta-bsp-custom \
"
```

## Module 2/Chapter5/conf/local.conf
```bitbake
MACHINE ??= 'wandboard-quad'
DISTRO ?= 'poky'
PACKAGE_CLASSES ?= "package_rpm"
EXTRA_IMAGE_FEATURES = "debug-tweaks"
USER_CLASSES ?= "buildstats image-mklibs image-prelink"
PATCHRESOLVE = "noop"
BB_DISKMON_DIRS = "\
    STOPTASKS,${TMPDIR},1G,100K \
    STOPTASKS,${DL_DIR},1G,100K \
    STOPTASKS,${SSTATE_DIR},1G,100K \
    ABORT,${TMPDIR},100M,1K \
    ABORT,${DL_DIR},100M,1K \
    ABORT,${SSTATE_DIR},100M,1K"
PACKAGECONFIG_append_pn-qemu-native = " sdl"
PACKAGECONFIG_append_pn-nativesdk-qemu = " sdl"
ASSUME_PROVIDED += "libsdl-native"
CONF_VERSION = "1"

BB_NUMBER_THREADS = '8'
PARALLEL_MAKE = '-j 8'

DL_DIR ?= "${BSPDIR}/downloads/"
ACCEPT_FSL_EULA = "1"

# Ch 1, Building your first image
INHERIT += "rm_work"
RM_OLD_IMAGE = "1"
RM_WORK_EXCLUDE = "linux-wandboard helloworld"

PRSERV_HOST = "localhost:0"

# Ch 5, Analyzing core dumps
#EXTRA_IMAGE_FEATURES += "dbg-pkgs"

# Ch 5, Native gdb debugging
#EXTRA_IMAGE_FEATURES += "tools-sdk dbg-pkgs tools-debug"

# Ch 5, Using the kernel's performance counters
EXTRA_IMAGE_FEATURES += "ssh-server-openssh"

# Ch 5, Tracing and profiling with perf
EXTRA_IMAGE_FEATURES += "tools-profile"
#INHIBIT_PACKAGE_STRIP = "1"
#EXTRA_IMAGE_FEATURES += "dbg-pkgs"
#PACKAGE_DEBUG_SPLIT_STYLE = 'debug-file-directory'
#DEBUG_BUILD = "1"

# Ch 5, Using LTTng
IMAGE_INSTALL_append = " lttng-tools lttng-modules lttng-ust"
EXTRA_IMAGE_FEATURES += "tools-sdk dev-pkgs"
IMAGE_INSTALL_append = " lttng-ust-bin"
```
